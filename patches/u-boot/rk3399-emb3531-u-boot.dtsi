// SPDX-License-Identifier: GPL-2.0+
/*
 * Copyright (C) 2019 Jagan Teki <jagan@amarulasolutions.com>
 */

#include "rk3399-u-boot.dtsi"
#include "rk3399-sdram-ddr3-1866.dtsi"

/ {
	chosen {
		stdout-path = "serial2:115200n8";
		u-boot,spl-boot-order = "same-as-spl", &sdmmc, &sdhci;
	};
};

&vdd_log {
	regulator-init-microvolt = <950000>;
};
